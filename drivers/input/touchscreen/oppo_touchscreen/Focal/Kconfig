## drivers/input/touchscreen/oppo_touchscreen/Focal/Kconfig
```kconfig
source "drivers/input/touchscreen/oppo_touchscreen/Focal/FT8006/Kconfig"
source "drivers/input/touchscreen/oppo_touchscreen/Focal/ft3518/Kconfig"
source "drivers/input/touchscreen/oppo_touchscreen/Focal/ft8006s_aa/Kconfig"
source "drivers/input/touchscreen/oppo_touchscreen/Focal/ft8722/Kconfig"
```

## drivers/input/touchscreen/oppo_touchscreen/Focal/ft8006s_aa/Kconfig
```kconfig
config TOUCHPANEL_FOCAL_FT8006S_AA
	bool "TP Focal_FT8006S_AA IC enable or not for OPPO"
	---help---
	say Y to enable driver for Touchpanel using Focal FT8006S-AA
```

## drivers/input/touchscreen/oppo_touchscreen/Focal/ft8722/Kconfig
```kconfig
config TOUCHPANEL_FOCAL_FT8722
	bool "TP Focal_FT8722 IC enable or not for OPPO"
	---help---
	say Y to enable driver for Touchpanel using Focal FT8006S-AA
```
